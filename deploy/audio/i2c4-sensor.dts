/dts-v1/;
/plugin/;

/* Sensor I2C4 M0 on header pins 27 (SDA) and 28 (SCL). */
/ {
    compatible = "rockchip,rk3566";
    fragment@0 {
        target = <&i2c4>;
        __overlay__ {
            status = "okay";
            clock-frequency = <100000>;
            pinctrl-names = "default";
            pinctrl-0 = <&i2c4m0_xfer>;
        };
    };
};
